## boards/arm/fkmg_stm32f405/Kconfig.fkmg_stm32f405
```kconfig
# Copyright (c) 2016 Linaro Limited.
# SPDX-License-Identifier: Apache-2.0

config BOARD_FKMG_STM32F405
	select SOC_STM32F405XX
```

## boards/arm/fkmg_stm32f405/fkmg_stm32f405_defconfig
```kconfig
# SPDX-License-Identifier: Apache-2.0

# Enable MPU
CONFIG_ARM_MPU=y

# Enable HW stack protection
CONFIG_HW_STACK_PROTECTION=y

CONFIG_SERIAL=y

# console
CONFIG_CONSOLE=y
CONFIG_UART_CONSOLE=y

# enable GPIO
CONFIG_GPIO=y

# enable ADC
CONFIG_ADC=y

# enable SPI
CONFIG_SPI=y
CONFIG_SPI_STM32=y
CONFIG_SPI_ASYNC=y
CONFIG_SPI_STM32_DMA=y

# enable I2C
CONFIG_I2C=y
CONFIG_I2C_STM32=y
```
